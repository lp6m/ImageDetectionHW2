/dts-v1/;/plugin/;
/ {
    fragment@0 {
        target-path = "/amba_pl@0";
        __overlay__ {
	    #address-cells = <2>;
            #size-cells = <2>;
            axi_dma_0 {
                compatible = "generic-uio";
                reg = <0x0 0xA001C000 0x0 0x1000>;
            };
        };
    };
};


