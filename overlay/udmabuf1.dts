/dts-v1/;/plugin/;
/ {
    fragment@0 {
        target-path = "/amba_pl@0";
        #address-celss = <2>;
        #size-cells = <2>;
        __overlay__ {
            udmabuf1 {
                compatible = "ikwzm,udmabuf-0.10.a";
                device-name="udmabuf1";
                size = <0x00050000>;
            };
        };
    };
};
